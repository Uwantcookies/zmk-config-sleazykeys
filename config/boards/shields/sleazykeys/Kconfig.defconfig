## config/boards/shields/sleazykeys/Kconfig.defconfig
```kconfig
# Copyright (c) 2020 The ZMK Contributors
# SPDX-License-Identifier: MIT

if SHIELD_SLEAZYKEYS_LEFT

config ZMK_KEYBOARD_NAME
    default "sleazykeys"

config ZMK_SPLIT_ROLE_CENTRAL
    default y

endif

if SHIELD_SLEAZYKEYS_LEFT || SHIELD_SLEAZYKEYS_RIGHT

config ZMK_SPLIT
    default y

endif
```

## config/boards/shields/sleazykeys/Kconfig.shield
```kconfig
# Copyright (c) 2020 The ZMK Contributors
# SPDX-License-Identifier: MIT

config SHIELD_SLEAZYKEYS_LEFT
    def_bool $(shields_list_contains,sleazykeys_left)

config SHIELD_SLEAZYKEYS_RIGHT
    def_bool $(shields_list_contains,sleazykeys_right)
```
